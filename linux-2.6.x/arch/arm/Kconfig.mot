## linux-2.6.x/arch/arm/mach-mxc91321/Kconfig
```kconfig
menu "MXC91331 Options"
	depends on ARCH_MXC91331

choice
	prompt "Board type"
	default MACH_I30030EVB

config MACH_I30030EVB
	bool "Support i.300-30 EVB platforms"
	help
	  Include support for i.300-30 EVB platform. This includes specific
	  configurations for the board and its peripherals.

config MACH_I30030ADS
	bool "Support i.300-30 ADS platforms"
	help
	  Include support for i.300-30 ADS platform. This includes
          specific configurations for the board and its peripherals.

endchoice

choice
	prompt "i.300-30 ADS Options"
	default MACH_I30030EVB_VER52A
        depends on MACH_I30030ADS

config MACH_I30030ADS_VER52
        bool "Support for PCB version 52"
        help
          Turn on this option to support board version 52.

config MACH_I30030ADS_VER52A
        bool "Support for PCB version 52A"
        help
          Turn on this option to support board version 52A.

endchoice
endmenu

menu "MXC91321 Options"
	depends on ARCH_MXC91321

choice
	prompt "Board type"
	default MACH_MXC30030EVB

config MACH_MXC30030EVB
	bool "Support MXC300-30 EVB platforms"
	help
	  Include support for MXC300-30 EVB platform. This includes specific
	  configurations for the board and its peripherals.

config MACH_ARGONLVREF
	bool "Support ArgonLV Reference platforms"
	help
	  Include support for the ArgonLV Reference platform. This includes specific 
	  configurations for the board and its peripherals.

config MACH_MXC30030ADS
	bool "Support MXC300-30 ADS platforms"
	help
	  Include support for MXC300-30 ADS platform. This includes specific
	  configurations for the board and its peripherals.

endchoice

endmenu
```

## linux-2.6.x/drivers/power_ic/core/Kconfig
```kconfig
# Copyright (C) 2005-2006 Motorola, Inc.
#
#  This program is free software; you can redistribute it and/or modify
#  it under the terms of the GNU General Public License version 2 as
#  published by the Free Software Foundation.
#
#  This program is distributed in the hope that it will be useful,
#  but WITHOUT ANY WARRANTY; without even the implied warranty of
#  MERCHANTABILITY or FITNESS FOR A PARTICULAR PURPOSE.  See the
#  GNU General Public License for more details.
#
#  You should have received a copy of the GNU General Public License
#  along with this program; if not, write to the Free Software
#  Foundation, Inc., 59 Temple Place, Suite 330, Boston, MA  02111-1307  USA
#
# Motorola 2006-Oct-06 - Update File
# Motorola 2006-Aug-03 - Linear Vibrator Support
# Motorola 2006-Jun-22 - Remove MOT_POWER_IC dependencies
# Motorola 2006-May-12 - Add Zeus support for SD
# Motorola 2005-Mar-25 - File re-written from scratch

menu "Power IC support"

config MOT_POWER_IC
        tristate "Motorola Power IC"
    ---help---
    This configuration enables the Power IC to be used by SCM-A11 and Zeus

config MOT_POWER_IC_ATLAS
        tristate "Motorola Power IC"
    depends on MOT_POWER_IC
    ---help---
    This configuration enables the Atlas to be used by SCM-A11 without affecting EzX    

config USR_BLK_DEV
        tristate "SD TransFlash support"
        depends on MOT_POWER_IC
        ---help---
        This configuration enables SD TransFlash driver support for SCM-A11 and Zeus

config LINEARVIBRATOR
    tristate "Linear Vibrator support"
    default n
    ---help---
    This configuration enables the linear vibrator for all platforms
endmenu
```
